## conf/distro/poky-cgl.conf
```bitbake
require conf/distro/poky-lsb.conf

DISTRO = "poky-cgl"

DISTRO_FEATURES_append = " pam selinux"
```

## meta-cgl-common/conf/distro/poky-cgl.conf
```bitbake
require conf/distro/poky-lsb.conf
require conf/distro/poky-selinux.conf

DISTRO = "poky-cgl"

IMAGE_CLASSES += "image_types_uboot"
PREFERRED_PROVIDER_virtual/refpolicy="refpolicy-targeted"

# we want to use rsyslog as the default syslog, but it's GPLv3, so need this
# check to switch to syslog-ng if GLPv3 is blacklisted.
VIRTUAL-RUNTIME_syslog ?= "${@bb.utils.contains('INCOMPATIBLE_LICENSE', 'GPLv3', 'syslog-ng', 'rsyslog', d)}"
```

## meta-cgl-common/conf/layer.conf
```bitbake
# We have a conf and classes directory, add to BBPATH
BBPATH .= ":${LAYERDIR}"

# We have recipes-* directories, add to BBFILES
BBFILES += "${LAYERDIR}/recipes-*/*/*.bb \
	${LAYERDIR}/images/* \
	${LAYERDIR}/packagegroups/* \
	${LAYERDIR}/recipes-*/*/*.bbappend"

BBFILE_COLLECTIONS += "meta-cgl-common"
BBFILE_PATTERN_meta-cgl-common = "^${LAYERDIR}/"
BBFILE_PRIORITY_meta-cgl-common = "7"
```

## meta-cgl-fsl-ppc/conf/layer.conf
```bitbake
# We have a conf and classes directory, add to BBPATH
BBPATH .= ":${LAYERDIR}"

# We have recipes-* directories, add to BBFILES
BBFILES += "${LAYERDIR}/recipes-*/*/*.bb \
	${LAYERDIR}/recipes-*/*/*.bbappend"

BBFILE_COLLECTIONS += "cgl-fsl-ppc"
BBFILE_PATTERN_cgl-fsl-ppc = "^${LAYERDIR}/"
BBFILE_PRIORITY_cgl-fsl-ppc = "7"

LAYERDEPENDS_cgl-fsl-ppc = "cgl-common"
```

## meta-fsl-ppc/conf/layer.conf
```bitbake
# We have a conf and classes directory, add to BBPATH
BBPATH .= ":${LAYERDIR}"

# We have recipes-* directories, add to BBFILES
BBFILES += "${LAYERDIR}/recipes-*/*/*.bb \
	${LAYERDIR}/recipes-*/*/*.bbappend"

BBFILE_COLLECTIONS += "cgl"
BBFILE_PATTERN_cgl = "^${LAYERDIR}/"
BBFILE_PRIORITY_cgl = "7"
```
